## dts/bindings/ethernet/mdio/raspberrypi,pico-mdio-pio.yaml
```yaml
# SPDX-FileCopyrightText: Copyright (c) 2026 Andrei-Edward Popa
# SPDX-License-Identifier: Apache-2.0

description: Raspberry Pi Pico PIO MDIO controller

compatible: "raspberrypi,pico-mdio-pio"

include: ["mdio-controller.yaml", "raspberrypi,pico-pio-device.yaml"]
```

## dts/bindings/flash_controller/st,stm8-flash-controller.yaml
```yaml
# SPDX-FileCopyrightText: Copyright (c) 2026 Andrei-Edward Popa
# SPDX-License-Identifier: Apache-2.0

description: STM8 Flash and data EEPROM controller
compatible: "st,stm8-flash-controller"
include: flash-controller.yaml
```

## dts/bindings/gpio/st,stm8-gpio.yaml
```yaml
# SPDX-FileCopyrightText: Copyright (c) 2026 Andrei-Edward Popa
# SPDX-License-Identifier: Apache-2.0

description: STM8S eight-bit GPIO port
compatible: "st,stm8-gpio"
include: [gpio-controller.yaml, base.yaml]

properties:
  reg:
    required: true
  "#gpio-cells":
    const: 2
  st,port-index:
    type: int
    required: true
    enum: [0, 1, 2, 3, 4, 5]
    description: GPIO port number, starting with port A
  st,exti-mask:
    type: int
    default: 0
    description: Pins supporting the normal port external interrupt
  st,pin-mask:
    type: int
    required: true
    description: Pins bonded in this package
  st,true-open-drain-mask:
    type: int
    default: 0
    description: Pins without a P-buffer or internal pull-up

gpio-cells:
  - pin
  - flags
```

## dts/bindings/i2c/st,stm8-i2c.yaml
```yaml
# SPDX-FileCopyrightText: Copyright (c) 2026 Andrei-Edward Popa
# SPDX-License-Identifier: Apache-2.0

description: STM8S I2C controller
compatible: "st,stm8-i2c"
include: [i2c-controller.yaml, pinctrl-device.yaml]
properties:
  reg:
    required: true
  interrupts:
    required: true
  clocks:
    required: true
  pinctrl-0:
    required: true
  pinctrl-names:
    required: true
  scl-gpios:
    type: phandle-array
    description: SCL GPIO used for bus recovery; requires sda-gpios.
  sda-gpios:
    type: phandle-array
    description: SDA GPIO used for bus recovery; requires scl-gpios.
```

## dts/bindings/interrupt-controller/st,stm8-itc.yaml
```yaml
# SPDX-FileCopyrightText: Copyright (c) 2026 Andrei-Edward Popa
# SPDX-License-Identifier: Apache-2.0

description: STM8 interrupt priority controller
compatible: "st,stm8-itc"
include: [base.yaml, interrupt-controller.yaml]
interrupt-cells:
  - irq
  - priority
```

## dts/bindings/mtd/st,stm8-eeprom.yaml
```yaml
# SPDX-FileCopyrightText: Copyright (c) 2026 Andrei-Edward Popa
# SPDX-License-Identifier: Apache-2.0

description: STM8 data EEPROM interface backed by the shared Flash controller
compatible: "st,stm8-eeprom"
include: base.yaml

properties:
  flash:
    type: phandle
    required: true
    description: Data EEPROM storage node managed by the STM8 Flash driver
```

## dts/bindings/mtd/st,stm8-nv-flash.yaml
```yaml
# SPDX-FileCopyrightText: Copyright (c) 2026 Andrei-Edward Popa
# SPDX-License-Identifier: Apache-2.0

description: STM8 internal program Flash or data EEPROM
compatible: "st,stm8-nv-flash"
include: soc-nv-flash.yaml

properties:
  reg:
    required: true
  erase-block-size:
    required: true
  write-block-size:
    required: true
  st,data-eeprom:
    type: boolean
    description: Use the data EEPROM unlock sequence instead of program Flash
```

## dts/bindings/pinctrl/st,stm8-pinctrl.yaml
```yaml
# SPDX-FileCopyrightText: Copyright (c) 2026 Andrei-Edward Popa
# SPDX-License-Identifier: Apache-2.0

description: |
  STM8S GPIO electrical configuration for fixed peripheral pin mappings.
  Pin groups contain STM8_PINMUX(port, pin) entries. Output states configure
  direction, idle level, push-pull or open-drain drive and slew rate; input
  states configure floating or pull-up inputs. Option-byte remapping is only
  checked against st,remap-mask/st,remap-value and is never programmed here.

compatible: "st,stm8-pinctrl"
include: base.yaml

child-binding:
  description: STM8 pin configuration state
  child-binding:
    description: Pins sharing the same electrical configuration
    include:
      - name: pincfg-node.yaml
        property-allowlist:
          - bias-disable
          - bias-pull-up
          - drive-push-pull
          - drive-open-drain
          - input-enable
          - output-enable
          - output-low
          - output-high
          - slew-rate
    properties:
      pinmux:
        type: array
        required: true
        description: GPIO port and pin, encoded with STM8_PINMUX
      slew-rate:
        default: 0
        enum: [0, 1]
        description: 0 selects the slow slope and 1 the fast slope
      st,remap-mask:
        type: int
        default: 0
        description: Required mask in the AFR option byte at 0x4803
      st,remap-value:
        type: int
        default: 0
        description: Required AFR bits selected by st,remap-mask
```

## dts/bindings/pwm/st,stm8-pwm.yaml
```yaml
# SPDX-FileCopyrightText: Copyright (c) 2026 Andrei-Edward Popa
# SPDX-License-Identifier: Apache-2.0

description: STM8 TIM1, TIM2 or TIM3 PWM outputs
compatible: "st,stm8-pwm"
include: [pwm-controller.yaml, base.yaml, pinctrl-device.yaml]
properties:
  pinctrl-0:
    required: true
  pinctrl-names:
    required: true
  "#pwm-cells":
    const: 3
pwm-cells:
  - channel
  - period
  - flags
```

## dts/bindings/serial/st,stm8-uart.yaml
```yaml
# SPDX-FileCopyrightText: Copyright (c) 2026 Andrei-Edward Popa
# SPDX-License-Identifier: Apache-2.0

description: STM8 UART1 and UART3
compatible: "st,stm8-uart"
include: [uart-controller.yaml, pinctrl-device.yaml]
properties:
  reg:
    required: true
  clocks:
    required: true
  pinctrl-0:
    required: true
  pinctrl-names:
    required: true
  current-speed:
    required: true
  interrupts:
    required: true
  interrupt-names:
    required: true
```

## dts/bindings/spi/st,stm8-spi.yaml
```yaml
# SPDX-FileCopyrightText: Copyright (c) 2026 Andrei-Edward Popa
# SPDX-License-Identifier: Apache-2.0

description: STM8S SPI controller and peripheral
compatible: "st,stm8-spi"
include: [spi-controller.yaml, pinctrl-device.yaml]
properties:
  reg:
    required: true
  interrupts:
    required: true
  clocks:
    required: true
  pinctrl-0:
    required: true
  pinctrl-names:
    required: true
  st,software-nss:
    type: boolean
    description: |
      Select the peripheral internally instead of using the hardware NSS input.
      The peripheral stays selected for the fixed-length transfer requested by
      the application. Ignored in controller mode.
```

## dts/bindings/timer/st,stm8-tim4.yaml
```yaml
# SPDX-FileCopyrightText: Copyright (c) 2026 Andrei-Edward Popa
# SPDX-License-Identifier: Apache-2.0

description: STM8 TIM4 periodic system timer
compatible: "st,stm8-tim4"
include: st,stm8-timer.yaml
```

## dts/bindings/timer/st,stm8-timer.yaml
```yaml
# SPDX-FileCopyrightText: Copyright (c) 2026 Andrei-Edward Popa
# SPDX-License-Identifier: Apache-2.0

description: STM8 TIM1, TIM2, TIM3 or TIM4 timer register block
compatible: "st,stm8-timer"
include: base.yaml
properties:
  reg:
    required: true
  interrupts:
    required: true
  clocks:
    required: true
  st,timer-id:
    type: int
    required: true
    enum: [1, 2, 3, 4]
  st,prescaler:
    type: int
    default: 64
    description: Clock divisor (1 to 65536 for TIM1; a power of two for TIM2 through TIM4)
  st,system-timer:
    type: boolean
    description: Reserve this instance for the system clock rather than the counter API
```

## dts/bindings/watchdog/st,stm8-iwdg.yaml
```yaml
# SPDX-FileCopyrightText: Copyright (c) 2026 Andrei-Edward Popa
# SPDX-License-Identifier: Apache-2.0

description: STM8 independent watchdog
compatible: "st,stm8-iwdg"
include: base.yaml
properties:
  reg:
    required: true
  clocks:
    required: true
```

## dts/bindings/watchdog/st,stm8-wwdg.yaml
```yaml
# SPDX-FileCopyrightText: Copyright (c) 2026 Andrei-Edward Popa
# SPDX-License-Identifier: Apache-2.0

description: STM8 window watchdog
compatible: "st,stm8-wwdg"
include: base.yaml
properties:
  reg:
    required: true
  clocks:
    required: true
```

## samples/subsys/shell/shell_module/boards/stm8s207k8.conf
```kconfig
# SPDX-FileCopyrightText: Copyright (c) 2026 Andrei-Edward Popa
# SPDX-License-Identifier: Apache-2.0

# Fit the shell commands, help and terminal editing in 64 KiB of flash with LTO.
CONFIG_SHELL_MINIMAL=y
CONFIG_SHELL_STACK_SIZE=1280
CONFIG_MAIN_STACK_SIZE=512
CONFIG_SHELL_HELP=y
CONFIG_SHELL_VT100_COMMANDS=y
CONFIG_LTO=y
CONFIG_CBPRINTF_NANO=y
CONFIG_LOG=n
CONFIG_LOG_CMDS=n
CONFIG_KERNEL_SHELL=n
CONFIG_DEVICE_SHELL=n
CONFIG_DATE_SHELL=n
CONFIG_THREAD_RUNTIME_STATS=n
CONFIG_THREAD_RUNTIME_STATS_USE_TIMING_FUNCTIONS=n
CONFIG_STATS=n
CONFIG_STATS_SHELL=n
CONFIG_THREAD_NAME=n
CONFIG_THREAD_MONITOR=n
CONFIG_TIMESLICING=n
CONFIG_BOOT_BANNER=y
CONFIG_STACK_SENTINEL=y
CONFIG_ASSERT=n
```

## soc/st/stm8/stm8s/Kconfig
```kconfig
# SPDX-FileCopyrightText: Copyright (c) 2026 Andrei-Edward Popa
# SPDX-License-Identifier: Apache-2.0

if SOC_SERIES_STM8S

config SOC_STM8S207K8
	select STM8
	select SOC_EARLY_INIT_HOOK
	select CLOCK_CONTROL
	select PINCTRL

endif
```

## soc/st/stm8/stm8s/Kconfig.defconfig
```kconfig
# SPDX-FileCopyrightText: Copyright (c) 2026 Andrei-Edward Popa
# SPDX-License-Identifier: Apache-2.0

if SOC_SERIES_STM8S

config SYS_CLOCK_HW_CYCLES_PER_SEC
	default $(dt_node_int_prop_int,/clock-controller@50c0,clock-frequency)

config MAIN_STACK_SIZE
	default 768

config IDLE_STACK_SIZE
	default 256

config SYSTEM_WORKQUEUE_STACK_SIZE
	default 512

config TIMEOUT_64BIT
	default n

choice LIBC_IMPLEMENTATION
	default MINIMAL_LIBC
endchoice

endif
```

## soc/st/stm8/stm8s/Kconfig.soc
```kconfig
# SPDX-FileCopyrightText: Copyright (c) 2026 Andrei-Edward Popa
# SPDX-License-Identifier: Apache-2.0

config SOC_FAMILY_STM8
	bool

config SOC_SERIES_STM8S
	bool
	select SOC_FAMILY_STM8

config SOC_STM8S207K8
	bool
	select SOC_SERIES_STM8S

config SOC_FAMILY
	default "stm8" if SOC_FAMILY_STM8

config SOC_SERIES
	default "stm8s" if SOC_SERIES_STM8S

config SOC
	default "stm8s207k8" if SOC_STM8S207K8
```
