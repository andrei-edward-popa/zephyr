## dts/bindings/rtc/raspberrypi,pico-rtc.yaml
```yaml
# Copyright (c) 2022 Andrei-Edward Popa
# SPDX-License-Identifier: Apache-2.0

include: [rtc.yaml, reset-device.yaml]

compatible: "raspberrypi,pico-rtc"

description: Raspberry Pi Pico Real Time Clock Driver
```
