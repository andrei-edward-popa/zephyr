## arch/stm8/Kconfig
```kconfig
# SPDX-FileCopyrightText: Copyright (c) 2026 Andrei-Edward Popa
# SPDX-License-Identifier: Apache-2.0

menu "STM8 architecture options"
	depends on STM8

config STM8_CONSOLE_TRACE
	bool "Capture console output in RAM"
	help
	  Retain the last 256 console bytes and a byte counter for debugger
	  inspection during board bring-up. UART output is independent of this
	  diagnostic trace.

config ARCH
	default "stm8"

config XIP
	default y

config ENFORCE_ZEPHYR_STDINT
	default n

config LINKER_ITERABLE_SUBALIGN
	default 1

config ARCH_DEVICE_STATE_ALIGN
	default 1

config ISR_STACK_SIZE
	default 1024

config NUM_IRQS
	default 30

config NUM_IRQ_PRIO_LEVELS
	int
	default 3

config GEN_ISR_TABLES
	default y

config GEN_IRQ_VECTOR_TABLE
	default n

config ISR_TABLES_LOCAL_DECLARATION
	default y

config ARCH_SW_ISR_TABLE_ALIGN
	default 1

config SYS_CLOCK_TICKS_PER_SEC
	default 1000

endmenu
```

## boards/st/stm8s207k8/Kconfig.stm8s207k8
```kconfig
# SPDX-FileCopyrightText: Copyright (c) 2026 Andrei-Edward Popa
# SPDX-License-Identifier: Apache-2.0

config BOARD_STM8S207K8
	select SOC_STM8S207K8
```

## boards/st/stm8s207k8/board.yml
```yaml
# SPDX-FileCopyrightText: Copyright (c) 2026 Andrei-Edward Popa
# SPDX-License-Identifier: Apache-2.0

board:
  name: stm8s207k8
  full_name: STM8S207K8 development board
  vendor: st
  socs:
    - name: stm8s207k8
```

## drivers/adc/Kconfig.stm8
```kconfig
# SPDX-FileCopyrightText: Copyright (c) 2026 Andrei-Edward Popa
# SPDX-License-Identifier: Apache-2.0

config ADC_STM8
	bool "STM8 ADC"
	default y
	depends on SOC_SERIES_STM8S
	depends on DT_HAS_ST_STM8_ADC_ENABLED
	select PINCTRL
	help
	  Enable interrupt-driven 10-bit conversions, software channel sequences,
	  oversampling and synchronous or asynchronous reads on ADC2.
```

## drivers/buzzer/Kconfig.stm8
```kconfig
# SPDX-FileCopyrightText: Copyright (c) 2026 Andrei-Edward Popa
# SPDX-License-Identifier: Apache-2.0

config BUZZER_STM8
	bool "STM8 beeper"
	default y
	depends on SOC_SERIES_STM8S
	depends on DT_HAS_ST_STM8_BEEP_ENABLED
	select PINCTRL
	help
	  Enable the hardware beeper with nonblocking tones and automatic stop.
	  The output has fixed duty and maps nonzero volume to its audible level.
	  The LSI clock source and pin remap must match the option bytes.
```

## drivers/clock_control/Kconfig.stm8
```kconfig
# SPDX-FileCopyrightText: Copyright (c) 2026 Andrei-Edward Popa
# SPDX-License-Identifier: Apache-2.0

config CLOCK_CONTROL_STM8
	bool "STM8S clock control driver"
	default y
	depends on SOC_SERIES_STM8S
	depends on DT_HAS_ST_STM8_CLOCK_ENABLED
	help
	  Control peripheral clock gates and report clock rates. The SoC early
	  initialization hook configures the HSI and CPU dividers. Supports HSI,
	  HSE and LSI oscillator control and boot clock source selection.

config CLOCK_CONTROL_STM8_RUNTIME
	bool "STM8 runtime clock configuration"
	depends on CLOCK_CONTROL_STM8
	help
	  Enable source switching and rate changes through clock_control_configure
	  and clock_control_set_rate. Update the system timer and idle peripherals
	  when the master clock changes; reject changes during active transfers.
```

## drivers/counter/Kconfig.stm8
```kconfig
# SPDX-FileCopyrightText: Copyright (c) 2026 Andrei-Edward Popa
# SPDX-License-Identifier: Apache-2.0

config COUNTER_STM8
	bool "STM8 timer counter driver"
	default y
	select COUNTER_SUPPORTS_CAPTURE
	select PINCTRL
	depends on SOC_SERIES_STM8S
	depends on DT_HAS_ST_STM8_COUNTER_ENABLED
	help
	  Up-counting, overflow, compare alarms and input captures on STM8 timers.
	  Instances reserved for the system clock are excluded.
```

## drivers/eeprom/Kconfig.stm8
```kconfig
# SPDX-FileCopyrightText: Copyright (c) 2026 Andrei-Edward Popa
# SPDX-License-Identifier: Apache-2.0

config EEPROM_STM8
	bool "STM8 internal data EEPROM"
	default y
	depends on STM8
	depends on DT_HAS_ST_STM8_EEPROM_ENABLED
	select FLASH
	help
	  Expose STM8 data EEPROM through the EEPROM API, using the shared
	  Flash controller for serialization and programming.
```

## drivers/ethernet/mdio/Kconfig.rpi_pico
```kconfig
# SPDX-FileCopyrightText: Copyright (c) 2026 Andrei-Edward Popa
# SPDX-License-Identifier: Apache-2.0

config MDIO_RPI_PICO_PIO
	bool "Raspberry Pi Pico PIO MDIO driver"
	default y
	depends on DT_HAS_RASPBERRYPI_PICO_MDIO_PIO_ENABLED
	depends on MDIO
	depends on PIO_RPI_PICO
```

## drivers/flash/Kconfig.stm8
```kconfig
# SPDX-FileCopyrightText: Copyright (c) 2026 Andrei-Edward Popa
# SPDX-License-Identifier: Apache-2.0

config FLASH_STM8
	bool "STM8 internal Flash and data EEPROM"
	default y
	depends on STM8
	depends on DT_HAS_ST_STM8_NV_FLASH_ENABLED
	select FLASH_HAS_DRIVER_ENABLED
	select FLASH_HAS_NO_EXPLICIT_ERASE
	select FLASH_HAS_PAGE_LAYOUT
	help
	  Support byte programming and block erasure of STM8 program Flash
	  and data EEPROM, including Flash addresses above 64 KiB.
```

## drivers/gpio/Kconfig.stm8
```kconfig
# SPDX-FileCopyrightText: Copyright (c) 2026 Andrei-Edward Popa
# SPDX-License-Identifier: Apache-2.0

config GPIO_STM8
	bool "STM8S GPIO driver"
	default y
	depends on SOC_SERIES_STM8S
	depends on DT_HAS_ST_STM8_GPIO_ENABLED
	help
	  Configure GPIO inputs, outputs and port operations. External interrupts
	  support rising, falling, both edges, and low level. The hardware has
	  no per-pin pending flags, so one interrupt pin is supported per port
	  vector. PD7's unmaskable TLI interrupt is unsupported.
```

## drivers/hwinfo/Kconfig.stm8
```kconfig
# SPDX-FileCopyrightText: Copyright (c) 2026 Andrei-Edward Popa
# SPDX-License-Identifier: Apache-2.0

config HWINFO_STM8
	bool "STM8S hardware information driver"
	default y
	depends on SOC_STM8S207K8
	select HWINFO_HAS_DRIVER
	help
	  Read the 96-bit factory ID and watchdog, debug, illegal opcode and
	  EMC reset flags. Power-on, brownout and pin resets have no cause flags.
```

## drivers/i2c/Kconfig.stm8
```kconfig
# SPDX-FileCopyrightText: Copyright (c) 2026 Andrei-Edward Popa
# SPDX-License-Identifier: Apache-2.0

config I2C_STM8
	bool "STM8S I2C driver"
	default y
	depends on DT_HAS_ST_STM8_I2C_ENABLED
	depends on MULTITHREADING
	select PINCTRL
	depends on CLOCK_CONTROL
	help
	  Enable the STM8S interrupt driven I2C controller and target driver.
	  Controller mode supports 7-bit and 10-bit addresses. Bus recovery
	  requires GPIO support and scl-gpios/sda-gpios devicetree properties.
	  Target mode supports one 7-bit or 10-bit address with byte callbacks.
```

## drivers/interrupt_controller/Kconfig.stm8
```kconfig
# SPDX-FileCopyrightText: Copyright (c) 2026 Andrei-Edward Popa
# SPDX-License-Identifier: Apache-2.0

config INTC_STM8
	bool "STM8 interrupt controller"
	default y
	depends on STM8 && DT_HAS_ST_STM8_ITC_ENABLED
	help
	  Manage STM8 interrupt priorities. Peripheral drivers register their
	  vector mask operation because ITC has no per-vector enable registers.
```

## drivers/pinctrl/Kconfig.stm8
```kconfig
# SPDX-FileCopyrightText: Copyright (c) 2026 Andrei-Edward Popa
# SPDX-License-Identifier: Apache-2.0

config PINCTRL_STM8
	bool "STM8S pin controller driver"
	default y
	depends on SOC_SERIES_STM8S
	depends on DT_HAS_ST_STM8_PINCTRL_ENABLED
	help
	  Configure GPIO direction, pull-up, output type and slew rate for
	  peripheral pins. Option-byte remapping must be configured separately.
```

## drivers/pwm/Kconfig.stm8
```kconfig
# SPDX-FileCopyrightText: Copyright (c) 2026 Andrei-Edward Popa
# SPDX-License-Identifier: Apache-2.0

config PWM_STM8
	bool "STM8 timer PWM"
	default y
	depends on SOC_SERIES_STM8S
	depends on DT_HAS_ST_STM8_PWM_ENABLED
	select PINCTRL
	help
	  Enable PWM outputs of the TIM1, TIM2 and TIM3 timers.
	  All channels of a timer share the period and prescaler.
```

## drivers/serial/Kconfig.stm8
```kconfig
# SPDX-FileCopyrightText: Copyright (c) 2026 Andrei-Edward Popa
# SPDX-License-Identifier: Apache-2.0

config UART_STM8
	bool "STM8 UART driver"
	default y
	depends on SOC_SERIES_STM8S
	depends on DT_HAS_ST_STM8_UART_ENABLED
	select CLOCK_CONTROL
	select PINCTRL
	select SERIAL_HAS_DRIVER
	select SERIAL_SUPPORT_INTERRUPT
	help
	  UART1 and UART3 polling and interrupt-driven transmit and receive,
	  Includes runtime baud rate, parity, data bit and stop bit configuration,
	  FIFO access, callbacks and receive error reporting.
```

## drivers/spi/Kconfig.stm8
```kconfig
# SPDX-FileCopyrightText: Copyright (c) 2026 Andrei-Edward Popa
# SPDX-License-Identifier: Apache-2.0

config SPI_STM8
	bool "STM8S SPI driver"
	default y
	depends on DT_HAS_ST_STM8_SPI_ENABLED
	depends on MULTITHREADING
	select PINCTRL
	depends on CLOCK_CONTROL
	help
	  Enable the STM8S interrupt driven SPI controller and peripheral driver.
	  Peripheral mode uses a pinctrl state named "peripheral" and supports
	  hardware NSS or software selection for fixed-length transfers.
```

## drivers/timer/Kconfig.stm8
```kconfig
# SPDX-FileCopyrightText: Copyright (c) 2026 Andrei-Edward Popa
# SPDX-License-Identifier: Apache-2.0

config STM8_TIM4_TIMER
	bool "STM8 TIM4 system timer"
	default y
	select TICKLESS_CAPABLE
	depends on SOC_SERIES_STM8S
	depends on DT_HAS_ST_STM8_TIM4_ENABLED
```

## drivers/watchdog/Kconfig.stm8
```kconfig
# SPDX-FileCopyrightText: Copyright (c) 2026 Andrei-Edward Popa
# SPDX-License-Identifier: Apache-2.0

config WDT_IWDG_STM8
	bool "STM8 independent watchdog"
	default y
	depends on SOC_SERIES_STM8S
	depends on DT_HAS_ST_STM8_IWDG_ENABLED
	select HAS_WDT_NO_CALLBACKS
	help
	  Enable the LSI-clocked watchdog. It cannot be stopped after setup.

config WDT_WWDG_STM8
	bool "STM8 window watchdog"
	default y
	depends on SOC_SERIES_STM8S
	depends on DT_HAS_ST_STM8_WWDG_ENABLED
	select HAS_WDT_NO_CALLBACKS
	help
	  Enable the CPU-clocked watchdog with a programmable feed window.
	  It cannot be stopped after setup and prevents CPU clock changes.
```

## dts/bindings/adc/st,stm8-adc.yaml
```yaml
# SPDX-FileCopyrightText: Copyright (c) 2026 Andrei-Edward Popa
# SPDX-License-Identifier: Apache-2.0

description: STM8 ten-bit successive-approximation converter
compatible: "st,stm8-adc"
include: [adc-controller.yaml, pinctrl-device.yaml]
properties:
  reg:
    required: true
  interrupts:
    required: true
  clocks:
    required: true
  pinctrl-0:
    required: true
  pinctrl-names:
    required: true
  st,channel-mask:
    type: int
    required: true
    description: Bit mask of analog input channels bonded in the package
  "#io-channel-cells":
    const: 1
io-channel-cells:
  - input
```

## dts/bindings/buzzer/st,stm8-beep.yaml
```yaml
# SPDX-FileCopyrightText: Copyright (c) 2026 Andrei-Edward Popa
# SPDX-License-Identifier: Apache-2.0

description: STM8 hardware beeper driven by the LSI oscillator
compatible: "st,stm8-beep"
include: [base.yaml, pinctrl-device.yaml]
properties:
  reg:
    required: true
  clocks:
    required: true
  pinctrl-0:
    required: true
  pinctrl-names:
    required: true
  beep-frequency:
    type: int
    default: 2000
    description: Default audible tone frequency in Hz
```

## dts/bindings/clock/st,stm8-clock.yaml
```yaml
# SPDX-FileCopyrightText: Copyright (c) 2026 Andrei-Edward Popa
# SPDX-License-Identifier: Apache-2.0

description: STM8S oscillator selection, CPU divider and peripheral clock gates
compatible: "st,stm8-clock"
include: [base.yaml, clock-controller.yaml]

properties:
  reg:
    required: true
  clock-frequency:
    type: int
    required: true
    description: Initial master clock frequency after source selection and division
  clocks:
    required: true
  clock-names:
    required: true
    description: HSI, HSE and LSI input clocks, named hsi, hse and lsi
  st,clock-source:
    type: string
    default: "hsi"
    enum: ["hsi", "hse", "lsi"]
    description: Initial master clock source
  "#clock-cells":
    const: 1
  st,hsi-divisor:
    type: int
    default: 1
    enum: [1, 2, 4, 8]
    description: HSI divider preceding the master clock
  st,cpu-divisor:
    type: int
    default: 1
    enum: [1, 2, 4, 8, 16, 32, 64, 128]
    description: CPU divider following the master clock

clock-cells:
  - id
```

## dts/bindings/counter/st,stm8-counter.yaml
```yaml
# SPDX-FileCopyrightText: Copyright (c) 2026 Andrei-Edward Popa
# SPDX-License-Identifier: Apache-2.0

description: STM8 counter and capture/compare channels
compatible: "st,stm8-counter"
include: [base.yaml, pinctrl-device.yaml]
properties:
  "#counter-capture-cells":
    type: int
    required: true
    const: 2
counter-capture-cells:
  - channel
  - flags
```

## dts/bindings/cpu/st,stm8.yaml
```yaml
# SPDX-FileCopyrightText: Copyright (c) 2026 Andrei-Edward Popa
# SPDX-License-Identifier: Apache-2.0

description: STMicroelectronics STM8 CPU
compatible: "st,stm8"
include: cpu.yaml
```
